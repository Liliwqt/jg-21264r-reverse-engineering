## firmware/gpio_bench/main/Kconfig.projbuild
```kconfig
menu "JG-21264R bench test"

config GPIO_BENCH_PIN_A
    int "Standalone test GPIO A"
    range 4 18
    default 4
    help
        Verify this GPIO is exposed and unused on your exact development board.
        This is an ESP32-only multimeter test, not a motor-driver assignment.

config GPIO_BENCH_PIN_B
    int "Standalone test GPIO B"
    range 4 18
    default 5
    help
        Must differ from GPIO A. Keep the RC board and motors disconnected.

config GPIO_BENCH_MOTOR_TEST
    bool "Enable manually armed 500 ms M1 motor test"
    default n
    help
        Requires the measured GPIO4/GPIO5 1k/10k interface and M1 socket.
        Each pulse requires a fresh arm command. Other motors disconnected.
        Never connect a motor when the ten-second standalone mode is selected.

endmenu
```

## firmware/gpio_bench/sdkconfig.defaults
```kconfig
CONFIG_ESP_CONSOLE_USB_SERIAL_JTAG=y
CONFIG_GPIO_BENCH_PIN_A=4
CONFIG_GPIO_BENCH_PIN_B=5
```
